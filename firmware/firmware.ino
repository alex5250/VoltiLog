#define __VERSION__ "2.3.1"
#define __RELEASE__ "8 Jan 2023"
#include <Wire.h>
#include <Adafruit_GFX.h>
#include <Adafruit_SSD1306.h>
#include <Wire.h>
#include <EEPROM.h>
#include <Eeprom24C32_64.h>

/** the current address in the EEPROM (i.e. which byte we're going to write to next) **/
int delay_address = 159;
unsigned long delay_in_millis = 100;
int counter = 0;
String command;

#define EEPROM_ADDRESS 0x50
static Eeprom24C32_64 external_eeprom(EEPROM_ADDRESS);

#define SCREEN_WIDTH 128
#define SCREEN_HEIGHT 64
#define PIN_INPUT A3
#define MAX_VALUE 4096

#define VOLTAGE_SENSOR A1
#define CURRENT_SENSOR A0
#define AREF_SENSOR A2
#define BUTTON A3

#define MAX_RANGE_CURRENT 0.888
#define MAX_RANGE_VOLTAGE 9.071

bool usb_mode = false;

Adafruit_SSD1306 display(SCREEN_WIDTH, SCREEN_HEIGHT, &Wire, -1);

static const unsigned char PROGMEM usb_icon_data[] = {
  0xff, 0xff, 0xff, 0xff, 0xff, 0xff, 0xff, 0xff, 0xff, 0xff, 0xff, 0xff, 0xff, 0xff, 0xff, 0xff,
  0xff, 0xff, 0xff, 0xff, 0xff, 0xff, 0xff, 0xff, 0xff, 0xff, 0xff, 0xff, 0xff, 0xff, 0xff, 0xff,
  0xff, 0xff, 0xff, 0xff, 0xff, 0xff, 0xff, 0xff, 0xff, 0xff, 0xff, 0xff, 0xff, 0xff, 0xff, 0xff,
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  0xff, 0xff, 0xff, 0xff, 0xff, 0xff, 0xff, 0xff, 0xff, 0xff, 0xff, 0xff, 0xff, 0xff, 0xff, 0xff
};




void detect_last_address() {
  int val = 0;
  while (true) {
    byte data = external_eeprom.readByte(word(val));
    delay(1);
    if (data == 0) {
      break;
    }
    if (val > 4096) {
      break;
    }
    val++;
    counter = val;
  }
}


void delay_data() {
  int delay_in_seconds = 0;
  delay_in_seconds = EEPROM.read(delay_address);
  delay_in_millis = 1 * 1000;
  //Serial.print("CONFIG:TIME:");
  // Serial.println(delay_in_millis);
}
//defines the writeEEPROM function


void usb_display() {
  display.clearDisplay();

  // Draw bitmap on the screen
  display.drawBitmap(0, 0, usb_icon_data, 128, 64, 1);
  // display.print(111);
  display.display();
}

void logo_display_on_boot() {

  if (!display.begin(SSD1306_SWITCHCAPVCC, 0x3C)) {
    Serial.println(F("SSD1306 allocation failed"));
    for (;;)
      ;
  }
  delay(2000);  // Pause for 2 seconds
  // Clear the buffer.
  display.clearDisplay();

  display.setTextSize(2);       // text size
  display.setTextColor(WHITE);  // text color
  display.setCursor(0, 10);     // position to display
  display.println("===>BOOT<====");
  display.display();
  delay(1000);
  display.clearDisplay();
  display.setTextSize(1);       // text size
  display.setTextColor(WHITE);  // text color
  display.setCursor(0, 0);      // position to display
  display.print("Version:");
  display.setCursor(70, 0);  // position to display
  display.println(__VERSION__);
  display.setTextColor(WHITE);  // text color
  display.setCursor(0, 10);     // position to display
  display.print("Release:");
  display.setCursor(50,10);  // position to display
  display.println(__RELEASE__);
  display.setCursor(0, 20);  // position to display
  display.print("Flash:");
  display.setCursor(50, 20);  // position to display
  display.println(__DATE__);
  display.setCursor(0, 30);  // position to display
  display.print("Flash time:");
  display.setCursor(70, 30);  // position to display
  display.println(__TIME__);
  display.display();
}
void setup() {
  Wire.begin();
  pinMode(PIN_INPUT, INPUT_PULLUP);
 // logo_display_on_boot();
  int input_button_value = digitalRead(PIN_INPUT);
  if (input_button_value == 0) usb_display();
  if (input_button_value == 0) usb_mode = true;

  analogReference(EXTERNAL);

  Serial.begin(115200);

  delay_data();



  //external_eeprom.initialize();
  delay(1000);
  //detect_last_address();

  // Serial.print("Current possition:");
  // Serial.println(counter);
}

void display_data(int counter) {
  float voltage = analogRead(VOLTAGE_SENSOR) * (MAX_RANGE_VOLTAGE / 1023.0);
  float current = analogRead(CURRENT_SENSOR) * (MAX_RANGE_CURRENT / 1023.0);
  display.clearDisplay();
  display.setTextSize(1);       // text size
  display.setTextColor(WHITE);  // text color
  display.setCursor(0, 10);     // position to display
  display.print("Voltage:");    // text to display
  display.setCursor(90, 10);    // position to display

  display.print(voltage);     // text to display
  display.println("V");       // text to display
  display.setCursor(0, 20);   // position to display
  display.print("Current:");  // text to display
  display.setCursor(90, 20);
  display.print(current);    // position to display
  display.println("A");      // text to display
  display.setCursor(0, 30);  // position to display
  display.print("Days left:");
  display.setCursor(90, 30);  // position to display
  int left_cells = MAX_VALUE - counter;
  unsigned long seconds = left_cells * (delay_in_millis);
  float days = (float)seconds / 86400000;
  display.println(days);
  display.setCursor(0, 40);
  display.print("EEPROM left:");
  display.setCursor(90, 40);
  display.println(4096 - counter);  // position to display
  display.setCursor(0, 50);
  display.print("Update cycle");
  display.setCursor(90, 50);
  display.print(delay_in_millis / 1000);
  display.println("s");









  // text to display
  display.display();  // show on OLED
}

void data_filled() {
}
void loop() {
  // put your main code here, to run repeatedly:
  if (usb_mode == false) {



    //write_last_address();


    int data_val = (float)(analogRead(A0)) / 4;
    int second_data = (float)(analogRead(A1)) / 4;

    float voltage = analogRead(VOLTAGE_SENSOR) * (MAX_RANGE_VOLTAGE / 1023.0);
    float current = analogRead(CURRENT_SENSOR) * (MAX_RANGE_CURRENT / 1023.0);

    Serial.print(voltage);
    Serial.print(",");
    Serial.println(current);




    //external_eeprom.writeByte(word(counter), data_val + 1);
    delay(100);
    //external_eeprom.writeByte(word(counter + 1), second_data + 1);
    delay(100);
    //byte data = external_eeprom.readByte(word(counter));
    // Print read byte.
    counter++;
    //display_data(counter);

    delay(delay_in_millis);
  } else {
    while (Serial.available()) {
      command = Serial.readStringUntil('\n');
      command.trim();
      if (command.equals("SYNC")) {
        delay(100);
        Serial.print("DATA+");
        Serial.println(counter);
        for (int i = 0; i < counter; i++) {

          byte data = external_eeprom.readByte(word(i));
          delay(10);
          byte data_2 = external_eeprom.readByte(word(i));
          Serial.print("0x");
          Serial.print(data);
          Serial.print(",");
          Serial.print("0x");
          Serial.println(data_2);
        }
        Serial.println("END");
      }
      if (command.equals("ERASE")) {
        for (int i = 0; i < counter; i++) {
          external_eeprom.writeByte(word(i), 0);
        }
        Serial.println("DONE");
      }
      if (command.equals("TIME")) {
        int time_val = 0;
        delay(100);
        Serial.println("ENTER TIME IN SECONDS: (0-255)");
        delay(100);
        char myData[20];
        byte m = Serial.readBytesUntil('\n', myData, 20);
        myData[m] = '\0';      //insert null charcater
        int x = atoi(myData);  //converts string to int
        Serial.println(x);     //shows 180
        time_val = x;

        if (time_val > 0) {
          EEPROM.write(delay_address, time_val);
          Serial.println("SET...OK");
          Serial.print("TIME SET:");
          Serial.println(time_val);
          Serial.print("DATA in EEPROM:");
          delay(100);
          int data = EEPROM.read(delay_address);
          Serial.println(data);
        }
      }
    }
  }
}
